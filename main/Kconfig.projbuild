## main/Kconfig.projbuild
```kconfig
menu "Camera Streamer Configuration"

    choice CAMERA_STREAMER_BOARD
        prompt "Target board"
        default CAMERA_STREAMER_BOARD_XIAO_ESP32S3_SENSE if IDF_TARGET_ESP32S3
        default CAMERA_STREAMER_BOARD_ESP32_TIMER_CAM
        help
            Select which camera board this firmware targets. Each board is tied
            to a specific chip, so set the matching target first
            (e.g. `idf.py set-target esp32` for the TimerCam or
            `idf.py set-target esp32s3` for the XIAO ESP32S3 Sense). The
            sdkconfig.defaults.<target> file selects the right board by default.

        config CAMERA_STREAMER_BOARD_ESP32_TIMER_CAM
            bool "M5Stack ESP32 TimerCam (OV3660)"
            depends on IDF_TARGET_ESP32
            help
                M5Stack ESP32 TimerCam. Streams MJPEG video over RTSP.

        config CAMERA_STREAMER_BOARD_XIAO_ESP32S3_SENSE
            bool "Seeed Studio XIAO ESP32S3 Sense (OV2640 + PDM mic)"
            depends on IDF_TARGET_ESP32S3
            help
                Seeed Studio XIAO ESP32S3 Sense. Streams MJPEG video plus L16
                PCM audio (from the onboard PDM microphone) over RTSP.
    endchoice

    config RTSP_SERVER_PORT
        int "RTSP Server Port"
        default 8554
        help
            The port number of the RTSP server.

    config RTSP_ACCEPT_TASK_STACK_SIZE
        int "RTSP accept task stack size (bytes)"
        range 2048 32768
        default 4096
        help
            Stack size for the RTSP server accept task.

    config RTSP_SESSION_TASK_STACK_SIZE
        int "RTSP session task stack size (bytes)"
        range 2048 32768
        default 4096
        help
            Stack size for the RTSP server session-dispatch task.

    config RTSP_CONTROL_TASK_STACK_SIZE
        int "RTSP control task stack size (bytes)"
        range 2048 32768
        default 8192
        help
            Stack size for each per-client RTSP control task. Increase this if
            the board reports a stack overflow in a task named like
            "RtspSession <id>".

    config ESP_WIFI_SSID
        string "WiFi SSID"
        default ""
        help
            SSID (network name) for the camera streamer to connect to.

    config ESP_WIFI_PASSWORD
        string "WiFi Password"
        default ""
        help
            WiFi password (WPA or WPA2) for the camera streamer to use.

    config ESP_MAXIMUM_RETRY
        int "Maximum retry"
        default 5
        help
            Set the Maximum retry to avoid station reconnecting to the AP unlimited when the AP is really inexistent.

endmenu
```

## sdkconfig.defaults
```kconfig
# Common defaults shared by all boards. Target-specific settings live in
# sdkconfig.defaults.<target> (esp32 -> TimerCam, esp32s3 -> XIAO ESP32S3 Sense),
# which ESP-IDF loads automatically in addition to this file.

CONFIG_COMPILER_OPTIMIZATION_PERF=y
# CONFIG_COMPILER_OPTIMIZATION_SIZE=y

CONFIG_FREERTOS_HZ=1000

# Common ESP-related
#
CONFIG_ESP_SYSTEM_EVENT_TASK_STACK_SIZE=4096
CONFIG_ESP_MAIN_TASK_STACK_SIZE=32768

# Run at full clock for camera + RTSP workloads
CONFIG_ESP_DEFAULT_CPU_FREQ_MHZ_240=y
CONFIG_ESP_DEFAULT_CPU_FREQ_MHZ=240

# SPIRAM Configuration
CONFIG_SPIRAM=y
CONFIG_SPIRAM_USE_MALLOC=y
CONFIG_SPIRAM_SPEED_80M=y

#
# Partition Table
#
CONFIG_PARTITION_TABLE_CUSTOM=y
CONFIG_PARTITION_TABLE_CUSTOM_FILENAME="partitions.csv"

# Networking tuning for higher-throughput streaming
CONFIG_LWIP_TCPIP_TASK_PRIO=23
CONFIG_ESP_WIFI_STATIC_RX_BUFFER_NUM=8
CONFIG_ESP_WIFI_DYNAMIC_RX_BUFFER_NUM=16
CONFIG_ESP_WIFI_STATIC_TX_BUFFER=y
CONFIG_ESP_WIFI_STATIC_TX_BUFFER_NUM=16
CONFIG_ESP_WIFI_AMPDU_TX_ENABLED=y
CONFIG_LWIP_TCP_SND_BUF_DEFAULT=16384
CONFIG_LWIP_TCP_WND_DEFAULT=16384
CONFIG_LWIP_TCP_RECVMBOX_SIZE=16
CONFIG_LWIP_UDP_RECVMBOX_SIZE=16
CONFIG_LWIP_TCPIP_RECVMBOX_SIZE=16
```

## sdkconfig.defaults.esp32
```kconfig
# M5Stack ESP32 TimerCam (OV3660). Loaded automatically by ESP-IDF in addition
# to sdkconfig.defaults when the target is esp32.
CONFIG_IDF_TARGET="esp32"

CONFIG_CAMERA_STREAMER_BOARD_ESP32_TIMER_CAM=y

# 4MB flash
CONFIG_ESPTOOLPY_FLASHSIZE_4MB=y
CONFIG_ESPTOOLPY_FLASHSIZE="4MB"
```

## sdkconfig.defaults.esp32s3
```kconfig
# Seeed Studio XIAO ESP32S3 Sense (OV2640 camera + PDM microphone). Loaded
# automatically by ESP-IDF in addition to sdkconfig.defaults when the target is
# esp32s3.
CONFIG_IDF_TARGET="esp32s3"

CONFIG_CAMERA_STREAMER_BOARD_XIAO_ESP32S3_SENSE=y

# 8MB flash
CONFIG_ESPTOOLPY_FLASHSIZE_8MB=y
CONFIG_ESPTOOLPY_FLASHSIZE="8MB"
CONFIG_ESPTOOLPY_FLASHMODE_QIO=y

# The ESP32-S3 has native USB; route the console to USB Serial/JTAG so the CLI
# works over the single USB-C connector.
CONFIG_ESP_CONSOLE_USB_SERIAL_JTAG=y

# Octal PSRAM on the ESP32-S3R8 module
CONFIG_SPIRAM_MODE_OCT=y

# Give esp-timer headroom for the camera + RTSP workload
CONFIG_ESP_TIMER_TASK_STACK_SIZE=6144

# RTSP task stack sizing (video + audio multitrack)
CONFIG_RTSP_ACCEPT_TASK_STACK_SIZE=4096
CONFIG_RTSP_SESSION_TASK_STACK_SIZE=4096
CONFIG_RTSP_CONTROL_TASK_STACK_SIZE=8192
```
